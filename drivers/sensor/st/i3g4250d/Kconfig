## drivers/sensor/st/i3g4250d/Kconfig
```kconfig
# I3G4250D three-axis digital output gyroscope

# Copyright (c) 2021 Jonathan Hahn
# SPDX-License-Identifier: Apache-2.0

config I3G4250D
	bool "I3G4250D three-axis digital output gyroscope"
	default y
	depends on DT_HAS_ST_I3G4250D_ENABLED
	depends on ZEPHYR_HAL_ST_MODULE
	select SPI
	select HAS_STMEMSC
	select USE_STDC_I3G4250D
	help
	  Enable driver for I3G4250D SPI-based three-axis motion tracking device.

config I3G4250D_STREAM
	bool "Use hardware FIFO to stream data"
	select I3G4250D_TRIGGER
	default y
	depends on SPI_RTIO
	depends on SENSOR_ASYNC_API
	help
	  Use this config option to enable streaming sensor data via RTIO subsystem.
```

## drivers/sensor/tdk/icm20948/Kconfig
```kconfig
# ICM20948
#
# Copyright (c) 2025 Aditya Ganesh
#
# SPDX-License-Identifier: Apache-2.0

menuconfig ICM20948
	bool "ICM20948 Six-Axis Motion Tracking Device"
	default y
	depends on DT_HAS_INVENSENSE_ICM20948_ENABLED
	select I2C
	help
	  Enable driver for ICM20948 I2C-based six-axis motion tracking device.
```

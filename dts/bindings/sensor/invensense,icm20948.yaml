## dts/bindings/sensor/invensense,icm20948.yaml
```yaml
# Copyright (c) 2021 Nordic Semiconductor
# SPDX-License-Identifier: Apache-2.0

description: |
  ICM20948 Motion sensor by invensense

compatible: "invensense,icm20948"

include: [sensor-device.yaml, i2c-device.yaml]

properties:
  int-gpios:
    type: phandle-array
    description: |
      The INT signal default configuration is active-high. The
      property value should ensure the flags properly describe the
      signal that is presented to the driver.

  accel-hz:
    type: int
    description: |
      Default frequency of accelerometer. (Unit - Hz)
      Maps to ACCEL_ODR field in ACCEL_CONFIG0 setting
      Power-on reset value is 1000.
    default: 1000
    enum:
      - 1
      - 3
      - 6
      - 12
      - 25
      - 50
      - 100
      - 200
      - 500
      - 1000
      - 2000
      - 4000
      - 8000
      - 16000
      - 32000

  gyro-hz:
    type: int
    description: |
      Default frequency of gyroscope. (Unit - Hz)
      Maps to GYRO_ODR field in GYRO_CONFIG0 setting
      Power-on reset value is 1000.
    default: 1000
    enum:
      - 1
      - 3
      - 6
      - 12
      - 25
      - 50
      - 100
      - 200
      - 500
      - 1000
      - 2000
      - 4000
      - 8000
      - 16000
      - 32000

  accel-fs:
    type: int
    description: |
      Default full scale of accelerometer. (Unit - g)
      Maps to ACCEL_FS_SEL field in ACCEL_CONFIG0 setting
      Power-on reset value is 16
    default: 2
    enum:
      - 2
      - 4
      - 8
      - 16

  gyro-fs:
    type: int
    description: |
      Default full scale of gyroscope. (Unit - DPS)
      Maps to GYRO_FS_SEL field in GYRO_CONFIG0 setting
      Power-on reset value is 250
    default: 250
    enum:
      - 250
      - 500
      - 1000
      - 2000

  mag-freq:
    type: int
    description: |
      Magnetometer frequency. (Unit - Hz)
      Maps to AK09916 CNTL2 operation mode setting
    default: 100
    enum:
      - 10
      - 20
      - 50
      - 100
```
